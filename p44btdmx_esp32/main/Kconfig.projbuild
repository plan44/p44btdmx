## p44btdmx_esp32/main/Kconfig.projbuild
```kconfig
menu "P44BTDMX-Controller Configuration"

config DEFAULT_LOG_LEVEL
    int "Log Level"
    default 5
    help
      Default log level (do not set >5 for normal operation)


config P44BTDMX_SYSTEMKEY
    string "P44BTDMX system key"
    default ""
    help
        Encryption/Obfuscation key for P44BTDMX protocol
        Can be a >=64 byte hex string to specify a binary system key
        or just a text <64 bytes for a text key
        or empty string to use the default key (basically: no key)

config P44_DMX_RX
    bool "DMX512 receiver"
    default n
    help
        Include DMX512 serial signal receiver

config P44_BTDMX_SENDER
    bool "Send P44BTDMX via BT"
    default n
    help
        This enables sending P44BTDMX via BT advertisements

config P44BTDMX_REFRESH_UNIVERSE
    depends on P44_BTDMX_SENDER
    bool "constantly re-send entire p44BTDMX universe values"
    default y
    help
        This enables sending not only changes, but also periodically refreshing all values in the universe (whenever no changes are pending)

config P44_BTDMX_LIGHTS
    bool "Build as a light controller"
    default y
    help
        Build light controller for PWM and WS281x LED chain lights

config P44BTDMX_PWMLIGHT
    depends on P44_BTDMX_LIGHTS
    bool "Enables PWM light as light #0"
    default n
    help
        This enables PWM R,G,B light as light #0 (instead of WS281x LED chain)


config P44_WIFI_SUPPORT
    bool "Enable Wifi in p44utils based app"
    help
        This enables using Wifi at all in p44utils based app

choice ESP_WIFI_MODE
    depends on P44_WIFI_SUPPORT
    prompt "AP or STA"
    default ESP_WIFI_IS_STATION
    help
        Whether the esp32 is softAP or station.

config ESP_WIFI_IS_SOFTAP
    bool "SoftAP"
config ESP_WIFI_IS_STATION
    bool "Station"
endchoice

config ESP_WIFI_MODE_AP
    bool
    depends on P44_WIFI_SUPPORT
    default y if ESP_WIFI_IS_SOFTAP
    default n if ESP_WIFI_IS_STATION

config ESP_WIFI_SSID
    string "WiFi SSID"
    depends on P44_WIFI_SUPPORT
    default "myssid"
    help
	SSID (network name) for the example to connect to.

config ESP_WIFI_PASSWORD
    string "WiFi Password"
    depends on P44_WIFI_SUPPORT
    default "mypassword"
    help
	WiFi password (WPA or WPA2) for the example to use.

config MAX_STA_CONN
    int "Max STA conn"
    depends on P44_WIFI_SUPPORT
    default 4
    help
	Max number of the STA connects to AP.

endmenu
```

## p44btdmx_esp32/sdkconfig.defaults
```kconfig
CONFIG_ESPTOOLPY_FLASHSIZE_4MB=y
CONFIG_ESPTOOLPY_BEFORE_NORESET=y
CONFIG_ESPTOOLPY_AFTER_NORESET=y
CONFIG_PARTITION_TABLE_CUSTOM=y
CONFIG_P44BTDMX_PWMLIGHT=y
CONFIG_BT_ENABLED=y
# CONFIG_BT_GATTS_ENABLE is not set
# CONFIG_BT_GATTC_ENABLE is not set
# CONFIG_BT_BLE_SMP_ENABLE is not set
# CONFIG_ETH_USE_ESP32_EMAC is not set
# CONFIG_ETH_USE_SPI_ETHERNET is not set
# CONFIG_ESP_HTTP_CLIENT_ENABLE_HTTPS is not set
# CONFIG_ESP32_WIFI_SW_COEXIST_ENABLE is not set
# CONFIG_FMB_COMM_MODE_ASCII_EN is not set
CONFIG_LWIP_SO_RCVBUF=y
CONFIG_LWIP_TCP_SYNMAXRTX=6
CONFIG_OPENSSL_ASSERT_DO_NOTHING=y
CONFIG_P44LRGRAPHICS_ENABLE_VIEWCONFIG=y
CONFIG_P44LRGRAPHICS_ENABLE_VIEWSTATUS=y
CONFIG_P44LRGRAPHICS_ENABLE_ANIMATION=y
CONFIG_P44UTILS_ENABLE_LEDCHAIN=y
CONFIG_P44UTILS_ENABLE_JSON=y
CONFIG_P44UTILS_ENABLE_P44SCRIPT=y
CONFIG_P44UTILS_ENABLE_P44LRGRAPHICS=y
```

## sdkconfig.defaults
```kconfig
# standard deug device on luz' macOS
CONFIG_ESPTOOLPY_PORT="/dev/cu.SLAB_USBtoUART"

# needed for ioctl FIONREAD to work
CONFIG_LWIP_SO_RCVBUF=y
```
